## firmware/sdkconfig.defaults
```kconfig
CONFIG_ESPTOOLPY_FLASHSIZE_4MB=y
CONFIG_PARTITION_TABLE_CUSTOM=y

CONFIG_BT_ENABLED=y
CONFIG_BT_CLASSIC_ENABLED=y
CONFIG_BT_SPP_ENABLED=y
CONFIG_BT_BLE_ENABLED=n
CONFIG_BTDM_CTRL_MODE_BR_EDR_ONLY=y

CONFIG_ESP_WIFI_IRAM_OPT=n
CONFIG_ESP_WIFI_RX_IRAM_OPT=n

CONFIG_WARDRIVER_OLED_SDA_GPIO=23
CONFIG_WARDRIVER_OLED_SCL_GPIO=22
CONFIG_WARDRIVER_GPS_RX_GPIO=16
CONFIG_WARDRIVER_GPS_TX_GPIO=17
```
